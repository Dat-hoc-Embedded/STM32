# file: Test_Semaphore_VSCode.ioc
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FREERTOS.Tasks01=defaultTask,24,128,StartDefaultTask,Default,NULL,Dynamic,NULL,NULL
Mcu.Family=STM32F4
Mcu.Name=STM32F411V(C-E)Tx
Mcu.Package=LQFP100
NVIC.PriorityGroup=NVIC_PRIORITYGROUP_4
ProjectManager.HeapSize=0x200
ProjectManager.StackSize=0x400
ProjectManager.TargetToolchain=CMake
RCC.AHBFreq_Value=16000000
RCC.APB1Freq_Value=16000000
RCC.APB2Freq_Value=16000000
RCC.CortexFreq_Value=16000000
RCC.HSE_VALUE=25000000
RCC.HSI_VALUE=16000000
RCC.LSE_VALUE=32768
RCC.SYSCLKFreq_VALUE=16000000
RCC.VCOOutputFreq_Value=192000000
VP_FREERTOS_VS_CMSIS_V2.Mode=CMSIS_V2
board=custom

// file: Core/Src/main.c
/* USER CODE BEGIN Header */
/**
 ******************************************************************************
 * @file           : main.c
 * @brief          : Main program body
 ******************************************************************************
 * @attention
 *
 * Copyright (c) 2025 STMicroelectronics.
 * All rights reserved.
 *
 * This software is licensed under terms that can be found in the LICENSE file
 * in the root directory of this software component.
 * If no LICENSE file comes with this software, it is provided AS-IS.
 *
 ******************************************************************************
 */
/* USER CODE END Header */
#include "main.h"
#include "stm32f4xx.h"
#include "cmsis_os.h"

/* Definitions for defaultTask */
osThreadId_t defaultTaskHandle;
const osThreadAttr_t defaultTask_attributes = {
	.name = "defaultTask",
	.stack_size = 128 * 4,
	.priority = (osPriority_t)osPriorityNormal,
};

void SystemClock_Config(void);
void Clock_Init();
void StartDefaultTask(void *argument);

uint32_t sys_fre = 0;
uint32_t a = 0;
int main(void)
{

	/* MCU Configuration--------------------------------------------------------*/

	/* Reset of all peripherals, Initializes the Flash interface and the Systick. */

	HAL_Init();

	/* Configure the system clock */
	//SystemClock_Config();
	Clock_Init();

	sys_fre = HAL_RCC_GetSysClockFreq();

	/* Initialize all configured peripherals */

	/* Init scheduler */
	osKernelInitialize();

	/* Create the thread(s) */
	/* creation of defaultTask */
	defaultTaskHandle = osThreadNew(StartDefaultTask, NULL, &defaultTask_attributes);

	/* Start scheduler */
	osKernelStart();

	/* We should never get here as control is now taken by the scheduler */

	/* Infinite loop */
	while (1)
	{

	}
}

#if 0
	void SystemClock_Config(void)
{
	RCC_OscInitTypeDef RCC_OscInitStruct = {0};
	RCC_ClkInitTypeDef RCC_ClkInitStruct = {0};

	/** Configure the main internal regulator output voltage
	 */
	__HAL_RCC_PWR_CLK_ENABLE();
	__HAL_PWR_VOLTAGESCALING_CONFIG(PWR_REGULATOR_VOLTAGE_SCALE1);

	/** Initializes the RCC Oscillators according to the specified parameters
	 * in the RCC_OscInitTypeDef structure.
	 */
	RCC_OscInitStruct.OscillatorType = RCC_OSCILLATORTYPE_HSI;
	RCC_OscInitStruct.HSIState = RCC_HSI_ON;
	RCC_OscInitStruct.HSICalibrationValue = RCC_HSICALIBRATION_DEFAULT;
	RCC_OscInitStruct.PLL.PLLState = RCC_PLL_NONE;
	if (HAL_RCC_OscConfig(&RCC_OscInitStruct) != HAL_OK)
	{
		Error_Handler();
	}

	/** Initializes the CPU, AHB and APB buses clocks
	 */
	RCC_ClkInitStruct.ClockType = RCC_CLOCKTYPE_HCLK | RCC_CLOCKTYPE_SYSCLK | RCC_CLOCKTYPE_PCLK1 | RCC_CLOCKTYPE_PCLK2;
	RCC_ClkInitStruct.SYSCLKSource = RCC_SYSCLKSOURCE_HSI;
	RCC_ClkInitStruct.AHBCLKDivider = RCC_SYSCLK_DIV1;
	RCC_ClkInitStruct.APB1CLKDivider = RCC_HCLK_DIV1;
	RCC_ClkInitStruct.APB2CLKDivider = RCC_HCLK_DIV1;

	if (HAL_RCC_ClockConfig(&RCC_ClkInitStruct, FLASH_LATENCY_0) != HAL_OK)
	{
		Error_Handler();
	}
}
#else
	void SystemClock_Config()
	{
		//  ------------------- SET UP 100MHZ
		// 1. Turn on HSE: 8 MHz
		RCC -> PLLCFGR |= RCC_PLLCFGR_PLLSRC_HSE ;

		// 2. PLLM = (/)8 ; PLLP = (/)2 ; PLLN = (*)200; (→ 100 MHz)
		RCC -> PLLCFGR &= ~(RCC_PLLCFGR_PLLM_Msk | RCC_PLLCFGR_PLLN_Msk | RCC_PLLCFGR_PLLP_Msk);
		RCC -> PLLCFGR |= ((8 << RCC_PLLCFGR_PLLM_Pos) | (200 << RCC_PLLCFGR_PLLN_Pos) | (0 << RCC_PLLCFGR_PLLP_Pos));

		// 3. Set wait states (cycles) for Flash (100 MHz @ Vdd >=2.7V → 3WS)
		FLASH -> ACR &= ~FLASH_ACR_LATENCY_Msk;
		FLASH -> ACR |= FLASH_ACR_LATENCY_3WS;

		// 4. ON HSE & PLL Clock
		RCC -> CR |= RCC_CR_HSEON;
		while (!(RCC -> CR & RCC_CR_HSERDY)); // WAIT HSERDY = 1
		RCC -> CR |= RCC_CR_PLLON;
		while (!(RCC -> CR & RCC_CR_PLLRDY));

		// 5. SET PRESCALERS FOR AHB, APB1, APB2
		RCC -> CFGR &= ~RCC_CFGR_HPRE; // AHB PRESCALER = /1

		RCC -> CFGR &= ~(RCC_CFGR_PPRE1_Msk);
		RCC -> CFGR |= RCC_CFGR_PPRE1_DIV2; // APB1 PRESCALER = /2 = 50 MHz

		RCC -> CFGR &= ~RCC_CFGR_PPRE2_Msk; // APB2 PRESCALER = /1
		RCC -> CFGR |= RCC_CFGR_PPRE2_DIV1; // APB2 PRESCALER = /1

		// 6. SWITCH SYSCLK TO PLL
		RCC -> CFGR &= ~RCC_CFGR_SW;
		RCC -> CFGR |= RCC_CFGR_SW_PLL;
		while((RCC->CFGR & RCC_CFGR_SWS) != RCC_CFGR_SWS_PLL);
	}
	void Clock_Init()
	{
		HAL_Init();
		SystemClock_Config(); // SET RCC -> CLOCK = 100 MHz
		SystemCoreClockUpdate();  // CẬP NHẬT HCLK → SystemCoreClock
		HAL_InitTick(TICK_INT_PRIORITY); // cập nhật lại SysTick theo HCLK mới

		// uint32_t PCLK1 = HAL_RCC_GetPCLK1Freq();
	}
#endif

void StartDefaultTask(void *argument)
{
	/* USER CODE BEGIN 5 */
	/* Infinite loop */
	for (;;)
	{
		a = 102;
		osDelay(1);
	}
	/* USER CODE END 5 */
}

void Error_Handler(void)
{
	__disable_irq();
	while (1)
	{
	}
}
